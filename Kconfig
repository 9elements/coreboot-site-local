## src/mainboard/Kconfig
```kconfig
choice
	prompt "Mainboard vendor"
	default VENDOR_EMULATION

source "site-local/src/mainboard/*/Kconfig.name"

endchoice

source "site-local/src/mainboard/*/Kconfig"
```

## src/mainboard/emulation/Kconfig
```kconfig
if VENDOR_EMULATION

choice
	prompt "Mainboard model"
	default BOARD_EMULATION_QEMU_X86_I440FX

source "site-local/src/mainboard/emulation/*/Kconfig.name"

endchoice

source "site-local/src/mainboard/emulation/*/Kconfig"

config MAINBOARD_VENDOR
	default "Emulation"

endif # VENDOR_EMULATION
```
